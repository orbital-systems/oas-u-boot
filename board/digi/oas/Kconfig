## board/digi/oas/Kconfig
```kconfig
if TARGET_OAS

config MCA
	bool
	default y

config SYS_BOARD
	default "imx6ul-oas"

config SYS_VENDOR
	default "digi"

config SYS_SOC
	default "mx6"

config SYS_CONFIG_NAME
	default "imx6ul-oas"

endif
```
